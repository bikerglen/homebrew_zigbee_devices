## CMakeLists.txt
```
#
# Copyright (c) 2020 Nordic Semiconductor ASA
#
# SPDX-License-Identifier: LicenseRef-Nordic-5-Clause
#

cmake_minimum_required(VERSION 3.20.0)

find_package(Zephyr REQUIRED HINTS $ENV{ZEPHYR_BASE})

project(zigbee_switch)

# NORDIC SDK APP START
target_sources(app PRIVATE
  src/main.c
  src/leds.c
  src/buttons.c
)

target_include_directories(app PRIVATE include)
# NORDIC SDK APP END

target_sources_ifdef(CONFIG_BT_NUS app PRIVATE
  src/nus_cmd.c
)
```

## Kconfig
```
#
# Copyright (c) 2020 Nordic Semiconductor ASA
#
# SPDX-License-Identifier: LicenseRef-Nordic-5-Clause
#

menu "Zephyr Kernel"
source "Kconfig.zephyr"
endmenu

module = NUS_CMD
module-str = NUS command
source "${ZEPHYR_BASE}/subsys/logging/Kconfig.template.log_config"
```

## prj.conf
```kconfig
#
# Copyright (c) 2020 Nordic Semiconductor ASA
#
# SPDX-License-Identifier: LicenseRef-Nordic-5-Clause
#

CONFIG_NCS_SAMPLES_DEFAULTS=y

CONFIG_UART_INTERRUPT_DRIVEN=y
CONFIG_SERIAL=n
CONFIG_GPIO=y

# Make sure printk is not printing to the UART console
CONFIG_CONSOLE=n
CONFIG_UART_CONSOLE=n

CONFIG_HEAP_MEM_POOL_SIZE=2048

CONFIG_ZIGBEE=y
CONFIG_ZIGBEE_APP_UTILS=y
CONFIG_ZIGBEE_ROLE_END_DEVICE=y

# Enable DK LED and Buttons library
CONFIG_DK_LIBRARY=n

# This example requires more workqueue stack
CONFIG_SYSTEM_WORKQUEUE_STACK_SIZE=2048

# Enable API for powering down unused RAM parts
CONFIG_RAM_POWER_DOWN_LIBRARY=y

# Networking
CONFIG_NET_IPV6=n
CONFIG_NET_IP_ADDR_CHECK=n
CONFIG_NET_UDP=n

CONFIG_ZIGBEE_CHANNEL_SELECTION_MODE_MULTI=y

CONFIG_NRFX_SAADC=y

CONFIG_ASSERT=n
```

## include/buttons.h
```c
#ifndef __LEDS_H__
#define __LEDS_H__

#include <zephyr/types.h>

#ifdef __cplusplus
extern "C" {
#endif

typedef void (*button_handler_t)(uint32_t button_state, uint32_t has_changed);

void buttons_init (button_handler_t button_handler);
void dk_read_buttons (uint32_t *button_state, uint32_t *has_changed);

// TODO

#ifdef __cplusplus
}
#endif

#endif
```

## include/leds.h
```c
#ifndef __LEDS_H__
#define __LEDS_H__

#include <zephyr/types.h>

#ifdef __cplusplus
extern "C" {
#endif

void led_init (void);
void led_set (uint8_t led_idx, uint32_t val);
void led_set_on (uint8_t led_idx);
void led_set_off (uint8_t led_idx);

#ifdef __cplusplus
}
#endif

#endif
```

## src/buttons.c
```c
#include <zephyr/kernel.h>
#include <zephyr/device.h>
#include <zephyr/devicetree.h>
#include <zephyr/drivers/gpio.h>

#include "buttons.h"

#define BUTTONS_NODE DT_PATH(buttons)

#define GPIO_SPEC_AND_COMMA(button_or_led) GPIO_DT_SPEC_GET(button_or_led, gpios),

static const struct gpio_dt_spec buttons[] = {
#if DT_NODE_EXISTS(BUTTONS_NODE)
	DT_FOREACH_CHILD(BUTTONS_NODE, GPIO_SPEC_AND_COMMA)
#endif
};

static uint32_t buttons_read (void);
static void buttons_changed (const struct device *gpio_dev, struct gpio_callback *cb, uint32_t pins);

static button_handler_t button_handler_cb;
static struct gpio_callback gpio_cb;
static atomic_t buttons_state;

void buttons_init (button_handler_t button_handler)
{
    int err;

    printk (">>> buttons init\n");

    button_handler_cb = button_handler;

    uint32_t pin_mask = 0;

    for (size_t i = 0; i < ARRAY_SIZE(buttons); i++) {
        printk ("initializing button %d\n", i);

        err = gpio_pin_configure_dt(&buttons[i], GPIO_INPUT);
        if (err) {
			printk ("Cannot configure button gpio");
			return err;
		}

		err = gpio_pin_interrupt_configure_dt(&buttons[i], GPIO_INT_TRIG_BOTH);
        if (err) {
			printk ("Cannot enable trig both callback");
			return err;
		}

		pin_mask |= BIT(buttons[i].pin);
	}

    printk ("pin_mask: %08x\n", pin_mask);

	gpio_init_callback (&gpio_cb, buttons_changed, pin_mask);

	for (size_t i = 0; i < ARRAY_SIZE(buttons); i++) {
		gpio_add_callback (buttons[i].port, &gpio_cb);
	}

	atomic_set (&buttons_state, (atomic_val_t)buttons_read ());

    dk_read_buttons (NULL, NULL);

    printk ("<<< buttons init\n");
}

static uint32_t buttons_read (void)
{
	uint32_t ret = 0;
	for (size_t i = 0; i < ARRAY_SIZE(buttons); i++) {
		int val;
		val = gpio_pin_get_dt(&buttons[i]);
		if (val) {
			ret |= 1U << i;
		}
	}
	return ret;
}

static void buttons_changed (const struct device *gpio_dev, struct gpio_callback *cb, uint32_t pins)
{
    printk ("button changed state\n");

    uint32_t last_buttons = atomic_get (&buttons_state);
    uint32_t this_buttons = buttons_read ();
    uint32_t changed_buttons = last_buttons ^ this_buttons;
 	atomic_set (&buttons_state, (atomic_val_t)this_buttons);

    printk ("buttons changed: last: %08x this: %08x changed: %08x\n", last_buttons, this_buttons, changed_buttons);

	button_handler_cb (this_buttons, changed_buttons);
}

void dk_read_buttons (uint32_t *button_state, uint32_t *has_changed)
{
	static uint32_t last_state;
	uint32_t current_state = atomic_get(&buttons_state);

	if (button_state != NULL) {
		*button_state = current_state;
	}

	if (has_changed != NULL) {
		*has_changed = (current_state ^ last_state);
	}

    printk ("dk_read_buttons: last: %08x this: %08x changed: %08x\n", last_state, current_state, *has_changed);

	last_state = current_state;
}
```

## src/leds.c
```c
#include <zephyr/kernel.h>
#include <zephyr/device.h>
#include <zephyr/devicetree.h>
#include <zephyr/drivers/gpio.h>

#include "leds.h"

#define LEDS_NODE DT_PATH(leds)

#define GPIO_SPEC_AND_COMMA(button_or_led) GPIO_DT_SPEC_GET(button_or_led, gpios),

static const struct gpio_dt_spec leds[] = {
#if DT_NODE_EXISTS(LEDS_NODE)
	DT_FOREACH_CHILD(LEDS_NODE, GPIO_SPEC_AND_COMMA)
#endif
};

void led_init (void)
{
	for (size_t i = 0; i < ARRAY_SIZE(leds); i++) {
		gpio_pin_configure_dt(&leds[i], GPIO_OUTPUT);
	}
}

void led_set (uint8_t led_idx, uint32_t val)
{
	if (led_idx >= ARRAY_SIZE(leds)) {
		return;
	}
	gpio_pin_set_dt(&leds[led_idx], val);
}

void led_set_on (uint8_t led_idx)
{
	led_set (led_idx, 1);
}

void led_set_off (uint8_t led_idx)
{
	led_set (led_idx, 0);
}
```
