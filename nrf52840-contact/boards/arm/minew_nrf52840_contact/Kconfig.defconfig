## nrf52840-contact/boards/arm/minew_nrf52840_contact/Kconfig.defconfig
```kconfig
# Copyright (c) 2024 Nordic Semiconductor ASA
# SPDX-License-Identifier: Apache-2.0

if BOARD_MINEW_NRF52840_CONTACT

config BOARD
	default "minew_nrf52840_contact"

config BT_CTLR
   default BT

endif
```

## nrf52840-four-input/boards/arm/minew_nrf52840_four_button/Kconfig.board
```kconfig
# Copyright (c) 2024 Nordic Semiconductor ASA
# SPDX-License-Identifier: Apache-2.0

config BOARD_MINEW_NRF52840_FOUR_BUTTON
	bool "Minew nRF52840 Four Button Zigbee Board"
	depends on SOC_NRF52840_QIAA
```

## nrf52840-four-input/boards/arm/minew_nrf52840_four_button/Kconfig.defconfig
```kconfig
# Copyright (c) 2024 Nordic Semiconductor ASA
# SPDX-License-Identifier: Apache-2.0

if BOARD_MINEW_NRF52840_FOUR_BUTTON

config BOARD
	default "minew_nrf52840_four_button"

config BT_CTLR
   default BT

endif
```

## nrf52840-four-input/boards/arm/minew_nrf52840_four_button/minew_nrf52840_four_button_defconfig
```kconfig
# Copyright (c) 2024 Nordic Semiconductor ASA
# SPDX-License-Identifier: Apache-2.0

CONFIG_SOC_SERIES_NRF52X=y
CONFIG_SOC_NRF52840_QIAA=y
CONFIG_BOARD_MINEW_NRF52840_FOUR_BUTTON=y

# Enable MPU
CONFIG_ARM_MPU=y

# Enable hardware stack protection
CONFIG_HW_STACK_PROTECTION=y

# Enable RTT
CONFIG_USE_SEGGER_RTT=y

# enable GPIO
CONFIG_GPIO=y

# enable uart driver
CONFIG_SERIAL=n

# enable console
CONFIG_CONSOLE=n
CONFIG_UART_CONSOLE=n

CONFIG_PINCTRL=y

# # Enable nRF ECB driver
CONFIG_CRYPTO=y
CONFIG_CRYPTO_NRF_ECB=y
CONFIG_CRYPTO_INIT_PRIORITY=80

# # Networking
CONFIG_MPSL=y
```
